-!    XLINK command file for AT90S8515.  512 bytes internal data address 
          space, 32Kbytes external SRAM, memory mapped I/O
          and 8 Kbytes program address space. -!

    -!    Define CPU type (AVR) -!

-ca90
      
    -! Define interrupt vector segment -!

-Z(CODE)INTVEC=0-1B

    -! Define segments in flash memory -!

-Z(CODE)RCODE,CDATA0,CDATA1,CCSTR,SWITCH,FLASH,CODE=1C-1FFF

    -! Define segments in RAM
    Built-in SRAM in 60-25F. The registers are in 0-1F and memory mapped I/O in 20-5F -!

    -! The IDATA0 and UDATA0 segments contains tiny variables, the segments must be placed within the reach of a tiny(8 bits) pointer. -!

-Z(DATA)IDATA0,UDATA0=60-FF
 
    -! Data stack in internal memory, size is 100(hex)bytes     -! 

-Z(DATA)ECSTR,CSTACK+100=100-25F
                           
    -! 32Kbytes external SRAM starting, using near variables        -!                             
    -! Return stack size is 40(hex) bytes in external RAM           -!
    -! First tell CSTARTUP that RSTACK is placed in External RAM    -!

-e?RSTACK_IN_EXTERNAL_RAM=?C_STARTUP

-Z(DATA)IDATA1,UDATA1,RSTACK+40=260-7FFF
                                                                        
    -! External memory mapped IO is used -!

-Z(DATA)NO_INIT=8000-FFFF 
                                                                         
    -!  Select reduced "printf" support to reduce library size.
        See the configuration section of the IAR C-compiler Users Guide concerning use of printf/sprintf. -!

-e_small_write=_formatted_write
-e_small_write_P=_formatted_write_P

    -!  Disable floating-point support in "scanf" to reduce library size.
    See the configuration section of the IAR C-compiler Users Guide concerning use of scanf/sscanf -!

-e_medium_read=_formatted_read
-e_medium_read_P=_formatted_read_P

    -! Suppress one warning which is not relevant for this processor -!

-w29

    -! Load the 'C' library -!

cl1s
 
