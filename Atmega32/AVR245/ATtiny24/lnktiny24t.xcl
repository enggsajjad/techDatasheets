//////////////////////////////////////////////////////////////////////////////
//                      - ATtiny24.xcl -                                    //
//                                                                          //
//   XLINK command file for the ICCA90 C-compiler using the -v0, -mt        //
//   options. Segments are defined for an ATtiny24 without external memory. //
//                                                                          //
//   Usage: xlink your_file(s) -f lnktiny24t                                //
//                                                                          //    
//   File version:  $evision$ 1.31                                         //
//                                                                          //
//////////////////////////////////////////////////////////////////////////////


/*
 * Modify the lines below to alter the size of the RSTACK, CSTACK and HEAP
 * segments. These need to be fine tuned to suit your specific application.
 * The '_..X_' prefix is used by C-SPY as an indication that the label should
 * not be displayed in the dissassembly window.
 */

-D_..X_CSTACK_SIZE=20  	/* 32 bytes for auto variables and saved registers. */
-D_..X_RSTACK_SIZE=20   /* 32 bytes for return addresses, equivalent to 16 */
                        /* levels of calls, including interrupts. */
-D_..X_HEAP_SIZE=10     /* 16 bytes of heap. */
-D_..X_TINY_HEAP_SIZE=10     /* 16 bytes of heap. */
-D_..X_NEAR_HEAP_SIZE=10     /* 16 bytes of heap. */

/* Define CPU */
-ca90

/*
 * The following segments are located in the internal memory of
 * the ATtiny24. Do not change these lines.
 */

/* Code memory */
-D_..X_INTVEC_SIZE=22     // 2 bytes * 17 vectors
-D_..X_FLASH_END=7FF      // End of flash memory

-Z(CODE)INTVEC=0-(_..X_INTVEC_SIZE-1)
-Z(CODE)TINY_F=_..X_INTVEC_SIZE-FF
-Z(CODE)NEAR_F=_..X_INTVEC_SIZE-_..X_FLASH_END
-Z(CODE)SWITCH=_..X_INTVEC_SIZE-_..X_FLASH_END
-Z(CODE)INITTAB=_..X_INTVEC_SIZE-_..X_FLASH_END
-Z(CODE)DIFUNCT=_..X_INTVEC_SIZE-_..X_FLASH_END
-Z(CODE)CODE=_..X_INTVEC_SIZE-_..X_FLASH_END
-Z(CODE)TINY_ID=_..X_INTVEC_SIZE-_..X_FLASH_END
-Z(CODE)NEAR_ID=_..X_INTVEC_SIZE-_..X_FLASH_END
-Z(CODE)CHECKSUM#_..X_FLASH_END

/* Internal data memory */
-D_..X_SRAM_BASE=60
-D_..X_SRAM_TEND=DF
-D_..X_SRAM_END=DF

-Z(DATA)TINY_I,TINY_Z,TINY_N=_..X_SRAM_BASE-_..X_SRAM_TEND
-Z(DATA)CSTACK+_..X_CSTACK_SIZE=_..X_SRAM_BASE-_..X_SRAM_TEND
-Z(DATA)HEAP+_..X_HEAP_SIZE=_..X_SRAM_BASE-_..X_SRAM_TEND
-Z(DATA)IOSTREAM_N#_..X_SRAM_BASE-_..X_SRAM_TEND
-Z(DATA)TINY_HEAP+_..X_TINY_HEAP_SIZE=_..X_SRAM_BASE-_..X_SRAM_TEND
-Z(DATA)RSTACK+_..X_RSTACK_SIZE=_..X_SRAM_BASE-_..X_SRAM_END
-Z(DATA)NEAR_I,NEAR_Z=_..X_SRAM_BASE-_..X_SRAM_END
-Z(DATA)NEAR_HEAP+_..X_NEAR_HEAP_SIZE=_..X_SRAM_BASE-_..X_SRAM_END

/* Internal eeprom memory */
-D_..X_EEPROM_END=7F     // End of eeprom memory
-D_..X_EEPROM_START=0

-Z(XDATA)EEPROM_I,EEPROM_N=_..X_EEPROM_START-_..X_EEPROM_END

/* Select reduced "printf" support to reduce library size.
   See configuration section in manual concerning printf/sprintf. */

/*Dlib*/
-e_PrintfSmall=_Printf

/*Clib*/
-e_small_write=_formatted_write
-e_small_write_P=_formatted_write_P

/* Disable floating-point support in "scanf" to reduce library size.
   See configuration section in manual concerning scanf/sscanf */

/*Dlib*/
-e_ScanfSmall=_Scanf

/*Clib*/
-e_medium_read=_formatted_read
-e_medium_read_P=_formatted_read_P

/* Suppress one warning which is not relevant for this processor */
-w29

/* Code will now reside in file aout.a90 or aout.d90, unless -o is specified */
/* .d90 is the default if debug system is linked (option -r) */
/* .a90 is the default without debugging. Default format is -Fmotorola */
